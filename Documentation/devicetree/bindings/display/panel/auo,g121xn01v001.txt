## Documentation/devicetree/bindings/display/panel/auo,g121xn01v001.txt
```
Auo G121XN01 V001 12.1" XGA TFT LCD panel

Required properties:
- compatible: should be "auo,g121xn01v001" or "auo,g121xn01v001_mx8m"

second compatible is for usage with i.MX8M/i.MX8MN/i.MX8MN with DSI to LVDS
display bridge

This binding is compatible with the simple-panel binding, which is specified
in simple-panel.txt in this directory.
```
